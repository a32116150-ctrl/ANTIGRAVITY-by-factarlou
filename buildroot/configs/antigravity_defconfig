## buildroot/configs/antigravity_defconfig
```kconfig
# ============================================================
# Antigravity POS — Buildroot Configuration
# Target: Raspberry Pi Zero 2 W (BCM2710, AArch64)
# ============================================================

# ── Target Architecture ─────────────────────────────────────
BR2_aarch64=y
BR2_cortex_a53=y

# ── Toolchain ───────────────────────────────────────────────
# Use Bootlin pre-built toolchain to avoid building glibc from
# source (which caused the previous OOM/disk-space CI failures)
BR2_TOOLCHAIN_EXTERNAL=y
BR2_TOOLCHAIN_EXTERNAL_BOOTLIN=y
BR2_TOOLCHAIN_EXTERNAL_BOOTLIN_AARCH64_GLIBC_STABLE=y

# ── System Configuration ────────────────────────────────────
BR2_TARGET_GENERIC_HOSTNAME="antigravity-pos"
BR2_TARGET_GENERIC_ISSUE="Antigravity POS v2"
BR2_INIT_SYSTEMD=y
BR2_ROOTFS_POST_BUILD_SCRIPT="board/antigravity/post-build.sh"
BR2_ROOTFS_POST_IMAGE_SCRIPT="board/antigravity/post-image.sh"
BR2_ROOTFS_OVERLAY="board/antigravity/overlay"

# Pass project root to post-build scripts via environment
BR2_ROOTFS_POST_SCRIPT_ARGS="$(BR2_EXTERNAL_DIRS)"

# ── Linux Kernel ────────────────────────────────────────────
BR2_LINUX_KERNEL=y
BR2_LINUX_KERNEL_CUSTOM_TARBALL=y
# Use stable RPi kernel branch
BR2_LINUX_KERNEL_CUSTOM_TARBALL_LOCATION="https://github.com/raspberrypi/linux/archive/refs/heads/rpi-6.1.y.tar.gz"
BR2_LINUX_KERNEL_DEFCONFIG="bcm2711"
BR2_LINUX_KERNEL_DTS_SUPPORT=y
# Zero 2 W DTS — MUST be bcm2710, not bcm2711
BR2_LINUX_KERNEL_INTREE_DTS_NAME="broadcom/bcm2710-rpi-zero-2-w"
BR2_LINUX_KERNEL_NEEDS_HOST_OPENSSL=y

# ── RPi Firmware ────────────────────────────────────────────
BR2_PACKAGE_RPI_FIRMWARE=y
# Use the STANDARD variant (NOT _PI4 — that's wrong for Zero 2 W)
# BR2_PACKAGE_RPI_FIRMWARE_VARIANT_PI=y is the default when none specified
# Explicitly unset the Pi4 variant:
# BR2_PACKAGE_RPI_FIRMWARE_VARIANT_PI4 is not set

# ── GPU / Display Drivers ───────────────────────────────────
BR2_PACKAGE_MESA3D=y
BR2_PACKAGE_MESA3D_GALLIUM_DRIVER_V3D=y
BR2_PACKAGE_MESA3D_GALLIUM_DRIVER_VC4=y
BR2_PACKAGE_MESA3D_OPENGL_EGL=y
BR2_PACKAGE_MESA3D_OPENGL_ES=y

# ── Qt6 Framework ───────────────────────────────────────────
BR2_PACKAGE_QT6=y
BR2_PACKAGE_QT6BASE_GUI=y
BR2_PACKAGE_QT6BASE_OPENGL=y
BR2_PACKAGE_QT6BASE_EGLFS=y
BR2_PACKAGE_QT6BASE_FONTCONFIG=y
BR2_PACKAGE_QT6DECLARATIVE=y
BR2_PACKAGE_QT6DECLARATIVE_QUICK=y

# ── Python 3 ────────────────────────────────────────────────
BR2_PACKAGE_PYTHON3=y
BR2_PACKAGE_PYTHON3_SQLITE=y

# NOTE: PySide6 is NOT a Buildroot package — it is installed via
# pip in the post-build script using the requirements.txt file.
# Do NOT add BR2_PACKAGE_PYTHON_PYSIDE6 here (it doesn't exist).
BR2_PACKAGE_PYTHON_PIP=y

# ── Utilities ───────────────────────────────────────────────
BR2_PACKAGE_F2FS_TOOLS=y
BR2_PACKAGE_SQUASHFS=y
BR2_PACKAGE_CA_CERTIFICATES=y

# ── Host Tools (needed by genimage for SD card creation) ────
BR2_PACKAGE_HOST_GENIMAGE=y
BR2_PACKAGE_HOST_MTOOLS=y
BR2_PACKAGE_HOST_DOSFSTOOLS=y

# ── Filesystem Images ────────────────────────────────────────
BR2_TARGET_ROOTFS_SQUASHFS=y
# BR2_TARGET_ROOTFS_TAR is not set
```
